## CMakeLists.txt
```
# native_sim 外设学习工程（Zephyr + native_sim）
# 无需真实开发板：程序直接在宿主机（PC）上编译并运行。
cmake_minimum_required(VERSION 3.20.0)
find_package(Zephyr REQUIRED HINTS $ENV{ZEPHYR_BASE})
project(native_sim_learn)

target_sources(app PRIVATE
  src/main.c
  src/app_led.c
  src/app_button.c
  src/app_eeprom.c
  src/app_entropy.c
)
```

## prj.conf
```kconfig
# ===== native_sim 外设学习示例：应用配置 =====
# 目标板 native_sim 已默认提供以下外设模型（见 native_sim.dts）：
#   - gpio0     : zephyr,gpio-emul        （可被程序读写的 GPIO 仿真控制器）
#   - led0      : 挂在 gpio0 pin0 上      （GPIO 输出）
#   - eeprom0   : zephyr,sim-eeprom        （EEPROM 仿真，落盘到 eeprom.bin）
#   - rng       : zephyr,native-posix-rng  （熵源/随机数模型）

# GPIO 子系统 + GPIO 仿真器
CONFIG_GPIO=y
CONFIG_GPIO_EMUL=y

# EEPROM 子系统（配套的 EEPROM_SIMULATOR 由 DTS 自动使能）
CONFIG_EEPROM=y

# 熵源子系统（配套的 FAKE_ENTROPY_NATIVE_POSIX 由 DTS 自动使能）
CONFIG_ENTROPY_GENERATOR=y

# 控制台 / 日志
CONFIG_PRINTK=y
CONFIG_LOG=y
```

## boards/native_sim.overlay
```dts
/*
 * native_sim 板级设备树覆盖（devicetree overlay）
 *
 * 板子自带的 native_sim.dts 已经有 led0（GPIO 输出）。
 * 这里再增加一个“虚拟按键” sw0，作为 GPIO 输入 + 中断演示的素材：
 *   - 节点挂在 gpio0 的 pin2 上；
 *   - 上拉 + 低电平有效（按下 = 低电平），与真实开发板上的用户按键一致；
 *   - 运行阶段由应用程序调用 gpio_emul_input_set() 注入电平来模拟“按下/松开”。
 */

#include <zephyr/dt-bindings/gpio/gpio.h>

/ {
	buttons {
		compatible = "gpio-keys";

		button0: button_0 {
			gpios = <&gpio0 2 (GPIO_PULL_UP | GPIO_ACTIVE_LOW)>;
			label = "Simulated button";
		};
	};

	aliases {
		sw0 = &button0;
	};
};
```

## src/main.c
```c
/*
 * native_sim 外设学习示例 —— 程序入口
 *
 * 目标板：native_sim
 *   —— 在 PC 上把 Zephyr 编译成一个普通的 Linux 可执行文件（zephyr.exe），
 *      程序本身充当“主板”，并自带若干外设模型，无需任何真实开发板。
 *
 * 本示例依次演示 4 类常见外设，各部分已拆分为独立模块：
 *   [1] GPIO 输出      ：app_led.c      —— 翻转 led0，并通过仿真器读回引脚电平
 *   [2] GPIO 输入+中断 ：app_button.c   —— sw0 按键，按下时触发中断
 *   [3] EEPROM         ：app_eeprom.c   —— 非易失存储，重启后数据仍在
 *   [4] 熵源 / 随机数  ：app_entropy.c  —— 从 rng 设备读取随机字节
 *
 * 运行：west build -b native_sim apps/native_sim_learn -d build/build_native_sim_learn
 *       build/build_native_sim_learn/zephyr/zephyr.exe
 */

#include <zephyr/sys/printk.h>

#include "app_led.h"
#include "app_button.h"
#include "app_eeprom.h"
#include "app_entropy.h"

#ifdef CONFIG_ARCH_POSIX
#include "posix_board_if.h"	/* posix_exit()：让 native_sim 程序干净退出 */
#endif

int main(void)
{
	printk("\n");
	printk("=================================================\n");
	printk(" Zephyr native_sim 外设学习示例\n");
	printk(" 无需真实开发板：程序直接作为 Linux 进程运行\n");
	printk("=================================================\n");

	demo_led();
	demo_button();
	demo_eeprom();
	demo_entropy();

	printk("\n全部演示结束。\n");

#ifdef CONFIG_ARCH_POSIX
	posix_exit(0);
#endif
	return 0;
}
```

## src/app_button.c
```c
/*
 * [2] GPIO 输入 + 中断：按键
 *
 * sw0 由 boards/native_sim.overlay 定义（上拉、低电平有效）。
 * 用另一个线程向 gpio0 注入高低电平来模拟“按下/松开”，
 * 中断处理函数被触发后通过信号量通知主流程。
 */

#include <zephyr/kernel.h>
#include <zephyr/drivers/gpio.h>
#include <zephyr/drivers/gpio/gpio_emul.h>
#include <zephyr/sys/printk.h>
#include <zephyr/sys/util.h>

#include "app_button.h"

/* sw0 = gpio0 pin2，由 boards/native_sim.overlay 定义（上拉、低电平有效） */
static const struct gpio_dt_spec button = GPIO_DT_SPEC_GET(DT_ALIAS(sw0), gpios);

#define BUTTON_PRESSES 3

static struct gpio_callback button_cb;
static struct k_sem button_pressed_sem;

static void button_isr(const struct device *port, struct gpio_callback *cb,
		       uint32_t pins)
{
	ARG_UNUSED(port);
	ARG_UNUSED(cb);
	ARG_UNUSED(pins);

	printk("  [中断] 按键按下！t = %u ms\n", k_uptime_get_32());
	k_sem_give(&button_pressed_sem);
}

/* 用“另一个线程”模拟真实世界的按键动作：向 gpio0 pin2 注入高低电平 */
static void button_sim_thread(void *p1, void *p2, void *p3)
{
	ARG_UNUSED(p1);
	ARG_UNUSED(p2);
	ARG_UNUSED(p3);

	for (int i = 1; i <= BUTTON_PRESSES; i++) {
		k_msleep(400);

		printk("  [仿真] 第 %d 次按下  (注入低电平)\n", i);
		gpio_emul_input_set(button.port, button.pin, 0);
		k_msleep(150);

		printk("  [仿真] 第 %d 次松开  (注入高电平)\n", i);
		gpio_emul_input_set(button.port, button.pin, 1);
	}
}

static K_THREAD_STACK_DEFINE(button_sim_stack, 1024);
static struct k_thread button_sim_tcb;

void demo_button(void)
{
	printk("\n=== [2] GPIO 输入 + 中断：按键 (sw0 / gpio0 pin%d) ===\n",
	       button.pin);

	if (!gpio_is_ready_dt(&button)) {
		printk("  错误：按键设备未就绪\n");
		return;
	}

	if (gpio_pin_configure_dt(&button, GPIO_INPUT) < 0) {
		printk("  错误：按键配置失败\n");
		return;
	}

	/* 低电平有效：等到“有效电平”（按下）时触发边沿中断 */
	if (gpio_pin_interrupt_configure_dt(&button, GPIO_INT_EDGE_TO_ACTIVE) < 0) {
		printk("  错误：中断配置失败\n");
		return;
	}

	gpio_init_callback(&button_cb, button_isr, BIT(button.pin));
	gpio_add_callback(button.port, &button_cb);

	k_sem_init(&button_pressed_sem, 0, BUTTON_PRESSES);

	/* 启动“仿真按键”线程，然后阻塞等待中断被触发 */
	k_thread_create(&button_sim_tcb, button_sim_stack,
			K_THREAD_STACK_SIZEOF(button_sim_stack),
			button_sim_thread, NULL, NULL, NULL,
			K_PRIO_PREEMPT(5), 0, K_NO_WAIT);

	printk("  等待 %d 次按键中断...\n", BUTTON_PRESSES);
	for (int i = 0; i < BUTTON_PRESSES; i++) {
		k_sem_take(&button_pressed_sem, K_FOREVER);
	}

	k_thread_join(&button_sim_tcb, K_FOREVER);
	gpio_remove_callback(button.port, &button_cb);
	printk("  共捕获 %d 次按键中断，GPIO 输入通路验证通过\n", BUTTON_PRESSES);
}
```

## src/app_button.h
```c
/*
 * [2] GPIO 输入 + 中断：按键
 */
#ifndef APP_BUTTON_H
#define APP_BUTTON_H

/* 用后台线程模拟按键动作，等待并统计 sw0 的边沿中断 */
void demo_button(void);

#endif /* APP_BUTTON_H */
```

## src/app_eeprom.c
```c
/*
 * [3] EEPROM：非易失存储
 *
 * eeprom-0 = eeprom0（zephyr,sim-eeprom），数据落盘到宿主机的 eeprom.bin，
 * 因此多次运行 zephyr.exe 时启动计数会持续累加。
 */

#include <zephyr/device.h>
#include <zephyr/devicetree.h>
#include <zephyr/drivers/eeprom.h>
#include <zephyr/sys/printk.h>

#include "app_eeprom.h"

#define EEPROM_MAGIC 0xEE9703U

struct eeprom_record {
	uint32_t magic;
	uint32_t boot_count;
};

void demo_eeprom(void)
{
	/* eeprom-0 = eeprom0（zephyr,sim-eeprom），数据落盘到 eeprom.bin */
	const struct device *eeprom = DEVICE_DT_GET(DT_ALIAS(eeprom_0));
	struct eeprom_record rec;
	int rc;

	printk("\n=== [3] EEPROM：非易失存储 (eeprom-0) ===\n");

	if (!device_is_ready(eeprom)) {
		printk("  错误：EEPROM 设备未就绪\n");
		return;
	}

	printk("  EEPROM 容量：%zu 字节\n", eeprom_get_size(eeprom));

	rc = eeprom_read(eeprom, 0, &rec, sizeof(rec));
	if (rc < 0) {
		printk("  读取失败（%d），按首次上电处理\n", rc);
		rec.magic = 0;
	}

	if (rec.magic != EEPROM_MAGIC) {
		rec.magic = EEPROM_MAGIC;
		rec.boot_count = 0;
	}
	rec.boot_count++;

	printk("  启动次数 = %u（多次运行 zephyr.exe，该值会持续累加）\n",
	       rec.boot_count);

	rc = eeprom_write(eeprom, 0, &rec, sizeof(rec));
	if (rc < 0) {
		printk("  写入失败：%d\n", rc);
	}
}
```

## src/app_eeprom.h
```c
/*
 * [3] EEPROM：非易失存储
 */
#ifndef APP_EEPROM_H
#define APP_EEPROM_H

/* 读取 eeprom-0 的启动计数并累加写回（数据落盘到 eeprom.bin） */
void demo_eeprom(void);

#endif /* APP_EEPROM_H */
```

## src/app_entropy.c
```c
/*
 * [4] 熵源 / 随机数
 *
 * native_sim 提供一个基于宿主机随机数的熵源设备（zephyr,native-posix-rng）。
 * 默认使用固定种子，加 --seed=<n> 可复现同一序列。
 */

#include <zephyr/device.h>
#include <zephyr/devicetree.h>
#include <zephyr/drivers/entropy.h>
#include <zephyr/sys/printk.h>

#include "app_entropy.h"

void demo_entropy(void)
{
	const struct device *rng = DEVICE_DT_GET(DT_CHOSEN(zephyr_entropy));
	uint8_t buf[16];
	int rc;

	printk("\n=== [4] 熵源 / 随机数 (rng) ===\n");

	if (!device_is_ready(rng)) {
		printk("  错误：随机数设备未就绪\n");
		return;
	}

	rc = entropy_get_entropy(rng, buf, sizeof(buf));
	if (rc < 0) {
		printk("  读取失败：%d\n", rc);
		return;
	}

	printk("  取到 %zu 字节随机数：", sizeof(buf));
	for (size_t i = 0; i < sizeof(buf); i++) {
		printk("%02x ", buf[i]);
	}
	printk("\n  （native_sim 默认使用固定种子，加 --seed=<n> 可复现同一序列）\n");
}
```

## src/app_entropy.h
```c
/*
 * [4] 熵源 / 随机数
 */
#ifndef APP_ENTROPY_H
#define APP_ENTROPY_H

/* 从 rng 设备读取一段随机字节并打印 */
void demo_entropy(void);

#endif /* APP_ENTROPY_H */
```

## src/app_led.c
```c
/*
 * [1] GPIO 输出：LED
 *
 * 翻转 led0，并通过 native_sim 的 GPIO 仿真器读回引脚电平，
 * 验证输出通路是否正确。
 */

#include <zephyr/kernel.h>
#include <zephyr/drivers/gpio.h>
#include <zephyr/drivers/gpio/gpio_emul.h>
#include <zephyr/sys/printk.h>

#include "app_led.h"

/* led0 = gpio0 pin0，来自板级设备树 */
static const struct gpio_dt_spec led = GPIO_DT_SPEC_GET(DT_ALIAS(led0), gpios);

void demo_led(void)
{
	printk("\n=== [1] GPIO 输出：LED (led0 / gpio0 pin%d) ===\n", led.pin);

	if (!gpio_is_ready_dt(&led)) {
		printk("  错误：LED 设备未就绪\n");
		return;
	}

	/* 配置为推挽输出，初始为灭 */
	if (gpio_pin_configure_dt(&led, GPIO_OUTPUT_INACTIVE) < 0) {
		printk("  错误：LED 配置失败\n");
		return;
	}

	for (int i = 1; i <= 4; i++) {
		gpio_pin_toggle_dt(&led);

		/*
		 * gpio_emul_output_get() 读取的是“仿真器内部记录的输出电平”，
		 * 相当于用万用表去量一根还没接灯珠的引脚——便于验证代码是否正确。
		 */
		int level = gpio_emul_output_get(led.port, led.pin);

		printk("  第 %d 次翻转 -> led0 = %s\n", i,
		       (level > 0) ? "亮(高电平)" : "灭(低电平)");
		k_msleep(300);
	}
}
```

## src/app_led.h
```c
/*
 * [1] GPIO 输出：LED
 */
#ifndef APP_LED_H
#define APP_LED_H

/* 翻转 led0 若干次，并通过仿真器读回引脚电平打印出来 */
void demo_led(void);

#endif /* APP_LED_H */
```
