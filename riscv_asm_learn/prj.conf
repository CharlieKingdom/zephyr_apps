## CMakeLists.txt
```
# RISC-V 32 位汇编学习工程（Zephyr + QEMU）
cmake_minimum_required(VERSION 3.20.0)
find_package(Zephyr REQUIRED HINTS $ENV{ZEPHYR_BASE})
project(riscv_asm_learn)

target_sources(app PRIVATE
  src/main.c
  src/asm_funcs.S
)

# CONFIG_LINKER_ORPHAN_SECTION_ERROR=y（见 prj.conf）本应注入 --orphan-handling=error，
# 但 Zephyr 的工具链能力检查会编译一个探测程序并用【默认】链接脚本试链：
# 探测程序自带的 .riscv.attributes 段在默认脚本下是孤儿段，error 模式使试链失败，
# 于是该旗标被误判为"工具链不支持"而静默丢弃（缓存在 ~/.cache/zephyr/ToolchainCapabilityDatabase）。
# Zephyr 自己的 linker.ld 显式放置了 .riscv.attributes，实际链接不会踩这个坑。
# 故在此直接注入裸旗标，绕过能力检查，让孤儿段在链接期就报 error。
zephyr_link_libraries(-Wl,--orphan-handling=error)

# CONFIG_OUTPUT_DISASSEMBLY=y（见 prj.conf）让每次链接后自动生成 zephyr.lst，
# 默认命令是 objdump -d -S。此处给 bintools 的反汇编旗标追加 -h：
# .lst 顶部先打印 ELF 段表（rom_start/text/datas/bss 等段的 Size/VMA/LMA/标志），
# 往下才是反汇编正文，一份文件同时看清"段级内存分布"与"指令编码"。
set_property(TARGET bintools PROPERTY disassembly_flag -d -h)
```

## prj.conf
```kconfig
# 使用板子默认的串口控制台（qemu_riscv32 defconfig 已使能 UART_CONSOLE）
CONFIG_PRINTK=y

# 孤儿段处置：链接器直接报错（默认是 warn，孤儿段会被静默乱放导致运行期无声挂死）
CONFIG_LINKER_ORPHAN_SECTION_ERROR=y

# 链接完成后自动生成反汇编清单 build/zephyr/zephyr.lst（objdump -d，默认再混排 C 源码）
CONFIG_OUTPUT_DISASSEMBLY=y
```

## src/main.c
```c
/*
 * RISC-V (RV32) 汇编学习示例 —— C 侧调用汇编函数
 *
 * 函数原型见下方 extern 声明，实现全部在 src/asm_funcs.S 中。
 * 教学点：RISC-V 调用约定（ilp32 ABI）
 *   - 参数：a0, a1, a2, ... a7
 *   - 返回：a0
 *   - 临时寄存器：t0-t6（调用者保存）
 *   - 被调用者保存：s0-s11、sp、ra
 */
#include <zephyr/kernel.h>
#include <zephyr/sys/printk.h>

extern int asm_add(int a, int b);        /* add 指令         */
extern int asm_sub(int a, int b);        /* sub 指令         */
extern int asm_mul(int a, int b);        /* mul 指令（M 扩展）*/
extern int asm_sum_to(int n);            /* 循环 + 分支      */
extern int asm_factorial(int n);         /* 递归 + 栈帧      */

int main(void)
{
	int a = 12, b = 5;

	printk("=== RISC-V RV32 汇编学习示例 ===\n");
	printk("asm_add(%d, %d)       = %d\n", a, b, asm_add(a, b));
	printk("asm_sub(%d, %d)       = %d\n", a, b, asm_sub(a, b));
	printk("asm_mul(%d, %d)       = %d\n", a, b, asm_mul(a, b));
	printk("asm_sum_to(%d)        = %d\n", 10, asm_sum_to(10));
	printk("asm_factorial(%d)     = %d\n", 6, asm_factorial(6));
	printk("=== 演示结束 ===\n");

	return 0;
}
```
